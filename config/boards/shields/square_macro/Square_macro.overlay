#include <dt-bindings/zmk/matrix_transform.h>
#include <physical_layouts.dtsi>
#include <dt-bindings/zmk/bt.h>

#include "seeed_xiao_ble.dtsi" // Include the base board definition

/ {
    chosen {
        zmk,physical-layout = &title72_physical_layout;
    };

    // The rest of your dtsi content will be included via Square_macro.dtsi
    // No need to redefine kscan0 gpios here as they are in Square_macro.dtsi
};